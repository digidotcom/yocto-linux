## drivers/mxc/pmic/mc13892/Kconfig
```kconfig
#
# PMIC Modules configuration
#

config MXC_MC13892_ADC
	tristate "MC13892 ADC support"
	depends on MXC_PMIC_MC13892
	---help---
	This is the MC13892 ADC module driver. This module provides kernel API
	for the ADC system of MC13892.
	It controls also the touch screen interface.
	If you want MC13892 ADC support, you should say Y here

config MXC_MC13892_RTC
	tristate "MC13892 Real Time Clock (RTC) support"
	depends on MXC_PMIC_MC13892
	---help---
	This is the MC13892 RTC module driver. This module provides kernel API
	for RTC part of MC13892.
	If you want MC13892 RTC support, you should say Y here

config MXC_MC13892_LIGHT
	tristate "MC13892 Light and Backlight support"
	depends on MXC_PMIC_MC13892
	---help---
	This is the MC13892 Light module driver. This module provides kernel API
	for led and backlight control part of MC13892.
	If you want MC13892 Light support, you should say Y here
config MXC_MC13892_BATTERY
	tristate "MC13892 Battery API support"
	depends on MXC_PMIC_MC13892
	---help---
	This is the MC13892 battery module driver. This module provides kernel API
	for battery control part of MC13892.
	If you want MC13892 battery support, you should say Y here

config MXC_MC13892_BATTERY_DEFAULT_CHARGING_CURRENT
	int "MC13892 Battery default charging current"
	depends on MXC_MC13892_BATTERY
	range 25 50
	default 40
	default 25 if (MACH_CCIMX51JS && WIRELESS)
	---help---
	It is recommended to have a battery connected when using the battery
	driver. However, if a battery is not connected the system will use
	this charging current threshold to determine whether a battery is present
	or not.
	Do not change this value unless instructed to by Digi support.

config MXC_MC13892_CONNECTIVITY
	tristate "MC13892 Connectivity API support"
	depends on MXC_PMIC_MC13892
	---help---
	This is the MC13892 connectivity module driver. This module provides kernel API
	for USB/RS232 connectivity control part of MC13892.
	If you want MC13892 connectivity support, you should say Y here
config MXC_MC13892_POWER
	tristate "MC13892 Power API support"
	depends on MXC_PMIC_MC13892
	---help---
	This is the MC13892 power and supplies module driver. This module provides kernel API
	for power and regulator control part of MC13892.
	If you want MC13892 power support, you should say Y here
```

## drivers/mxc/vpu/Kconfig
```kconfig
#
# Codec configuration
#

menu "MXC VPU(Video Processing Unit) support"

config MXC_VPU
	  tristate "Support for MXC VPU(Video Processing Unit)"
	  depends on (ARCH_MX3 || ARCH_MX27 || ARCH_MX37 || ARCH_MX5)
	  default y
	---help---
	  The VPU codec device provides codec function for H.264/MPEG4/H.263,
	  as well as MPEG2/VC-1/DivX on some platforms.

config MXC_VPU_IRAM
	bool "Use IRAM as temporary buffer for VPU to enhance performace"
	depends on (MODULE_CCIMX5X)
	default y
	help
	  The VPU can use internal RAM as temporary buffer to save external
	  memory bandwith, thus to enhance video performance.

config MXC_VPU_IRAM_SIZE
	int "IRAM size in bytes to use for the VPU."
	range 0 102400
	default 102400
	depends on (MXC_VPU_IRAM)
	help
	  Set the size of the IRAM used by the VPU as a temporary buffer to save
	  external memory bandwith and enhance video performance.
	  It should be determined by the video codec that uses the largest IRAM.
	  Typically this is VC-1AP for 1080p decoding (101760) and h.263-P3 for
	  720p encoding.

config MXC_VPU_DEBUG
	bool "MXC VPU debugging"
	depends on MXC_VPU != n
	help
	  This is an option for the developers; most people should
	  say N here.  This enables MXC VPU driver debugging.

endmenu
```

## drivers/net/wireless/digiPiper/Kconfig
```kconfig
config DIGI_PIPER_WIFI
	bool "Digi Piper Wifi support"
	depends on MAC80211 && WLAN_80211 && I2C && (MACH_CCW9P9215JS || MACH_CCW9M2443JS)
	---help---
	  This driver is for the Piper 802.11 MAC by Digi.  This MAC is
	  supported on the Digi ConnectCore Wi-9P 9215 and Digi ConnectCore Wi-9M 2443
	  embedded modules.

config PIPER_STATUS_LED
	bool "Enable GPIO for Wifi status LED"
	depends on DIGI_PIPER_WIFI && MACH_CCW9M2443JS
	default y
	help
	  ConnectCore Wi-9M 2443 does not provide any dedicated LED 
	  in the module for showing the Wifi status.
	  This option lets you define one available CPU GPIO for this purpose.
	  Default value is set to USER LED 1 on JumpStart board.

config PIPER_STATUS_LED_GPIO
	int "GPIO for Wifi status LED (0-144)"
	range 0 144
	depends on PIPER_STATUS_LED
	default "141"
	help
	  Set CPU GPIO for Wifi status LED.

	  Default: User LED 1 on JumpStart board (LE5)
```

## drivers/pwm/Kconfig
```kconfig
#
# PWM infrastructure and devices
#

menuconfig GENERIC_PWM
	tristate "PWM Support"
	help
	  This enables PWM support through the generic PWM library.
	  If unsure, say N.

if GENERIC_PWM

config ATMEL_PWM
	tristate "Atmel AT32/AT91 PWM support"
	depends on AVR32 || ARCH_AT91
	help
	  This option enables device driver support for the PWMC
	  peripheral channels found on certain Atmel processors.
	  Pulse Width Modulation is used many for purposes, including
	  software controlled power-efficent backlights on LCD
	  displays, motor control, and waveform generation.  If
	  unsure, say N.

config NS921X_PWM
	tristate "Digi NS921X PWM support"
	depends on PROCESSOR_NS9215 && !CC9P9215JS_SERIAL_PORTA && !CC9P9215JS_SPI && !CC9P9215JS_SERIAL_PORTC_CTSRTSRXTX && !CC9P9215JS_SERIAL_PORTC_FULL
	help
	  This option enables device driver support for the PWMC
	  peripheral channels found on certain NetSilicon processors.
	  Pulse Width Modulation is used many for purposes, including
	  software controlled power-efficent backlights on LCD
	  displays, motor control, and waveform generation.  If
	  unsure, say N.

config S3C2443_PWM
	tristate "Digi S3C2443 PWM support"
	depends on MACH_CC9M2443JS || MACH_CCW9M2443JS
	help
	  This option enables device driver support for the PWM
	  timers on S3C2443 processor.
	  Pulse Width Modulation is used many for purposes, including
	  software controlled power-efficent backlights on LCD
	  displays, motor control, and waveform generation.  If
	  unsure, say N.

config S3C2443_PWM_PRESCALER_0
	int "Prescaler 0 (for timers 0 and 1)"
	range 0 255
	default 2
	depends on S3C2443_PWM
	help
	  This value sets the prescaler 0 shared by PWM timers 0 and 1.
	  Allowed values range between 0 and 255, and the period that can
	  be generated can be calculated using these formulas:

            max_period = (65535 * 16 * (prescaler + 1) / PCLK)

	    min_period = (2 * 2 * (prescaler + 1) / PCLK)

          For example, for a PCLK of 66.75MHz and a prescaler of 2
	  the maximum period is 47.12 ms, and the minimum is 180 ns.

	  NOTE: Prescaler 1 (shared by timers 2, 3, and 4) cannot be
	  modified because timer 4 is used as system timer with a
	  fixed prescaler of 2.

config MXS_PWM
	tristate "Freescale MXS PWM support"
	depends on ARCH_MXS
	help
	  Generic PWM driver for Freescale MXS.

endif
```

## drivers/video/mxs/Kconfig
```kconfig
config FB_MXS
	tristate "MXS Framebuffer driver"
	depends on FB && ARCH_MXS
	select FB_CFB_FILLRECT
	select FB_CFB_COPYAREA
	select FB_CFB_IMAGEBLIT
	default y
	---help---
	  Say Y here to enable support for the framebuffer driver for the
	  Freescale MXS Board.

config FB_MXS_TVENC
	depends on ARCH_MXS
	bool "TVENC"
	---help---
	  Use TVOUT encoder for MXS
```

## net/wireless/Kconfig
```kconfig
config WIRELESS_EXT
	bool

config WEXT_CORE
	def_bool y
	depends on CFG80211_WEXT || WIRELESS_EXT

config WEXT_PROC
	def_bool y
	depends on PROC_FS
	depends on WEXT_CORE

config WEXT_SPY
	bool

config WEXT_PRIV
	bool

config CFG80211
	tristate "cfg80211 - wireless configuration API"
	depends on RFKILL || !RFKILL
	---help---
	  cfg80211 is the Linux wireless LAN (802.11) configuration API.
	  Enable this if you have a wireless device.

	  For more information refer to documentation on the wireless wiki:

	  http://wireless.kernel.org/en/developers/Documentation/cfg80211

	  When built as a module it will be called cfg80211.

config NL80211_TESTMODE
	bool "nl80211 testmode command"
	depends on CFG80211
	help
	  The nl80211 testmode command helps implementing things like
	  factory calibration or validation tools for wireless chips.

	  Select this option ONLY for kernels that are specifically
	  built for such purposes.

	  Debugging tools that are supposed to end up in the hands of
	  users should better be implemented with debugfs.

	  Say N.

config CFG80211_DEVELOPER_WARNINGS
	bool "enable developer warnings"
	depends on CFG80211
	default n
	help
	  This option enables some additional warnings that help
	  cfg80211 developers and driver developers, but that can
	  trigger due to races with userspace.

	  For example, when a driver reports that it was disconnected
	  from the AP, but the user disconnects manually at the same
	  time, the warning might trigger spuriously due to races.

	  Say Y only if you are developing cfg80211 or a driver based
	  on it (or mac80211).


config CFG80211_REG_DEBUG
	bool "cfg80211 regulatory debugging"
	depends on CFG80211
	default n
	---help---
	  You can enable this if you want to debug regulatory changes.
	  For more information on cfg80211 regulatory refer to the wireless
	  wiki:

	  http://wireless.kernel.org/en/developers/Regulatory

	  If unsure, say N.

config CFG80211_DEFAULT_PS
	bool "enable powersave by default"
	depends on CFG80211
	default y
	help
	  This option enables powersave mode by default.

	  If this causes your applications to misbehave you should fix your
	  applications instead -- they need to register their network
	  latency requirement, see Documentation/power/pm_qos_interface.txt.

config CFG80211_DEBUGFS
	bool "cfg80211 DebugFS entries"
	depends on CFG80211
	depends on DEBUG_FS
	---help---
	  You can enable this if you want to debugfs entries for cfg80211.

	  If unsure, say N.

config CFG80211_INTERNAL_REGDB
	bool "use statically compiled regulatory rules database" if EMBEDDED
	default n
	depends on CFG80211
	---help---
	  This option generates an internal data structure representing
	  the wireless regulatory rules described in net/wireless/db.txt
	  and includes code to query that database.  This is an alternative
	  to using CRDA for defining regulatory rules for the kernel.

	  For details see:

	  http://wireless.kernel.org/en/developers/Regulatory

	  Most distributions have a CRDA package.  So if unsure, say N.

config CFG80211_WEXT
	bool "cfg80211 wireless extensions compatibility"
	depends on CFG80211
	select WEXT_CORE
	default y
	help
	  Enable this option if you need old userspace for wireless
	  extensions with cfg80211-based drivers.

config WIRELESS_OLD_REGULATORY
	bool "Old wireless static regulatory definitions"
	default y
	---help---
	  This option enables the old static regulatory information
	  and uses it within the new framework. This is available
	  temporarily as an option to help prevent immediate issues
	  due to the switch to the new regulatory framework which
	  does require a new userspace application which has the
	  database of regulatory information (CRDA) and another for
	  setting regulatory domains (iw).

	  For more information see:

	  http://wireless.kernel.org/en/developers/Regulatory/CRDA
	  http://wireless.kernel.org/en/users/Documentation/iw

	  It is important to note though that if you *do* have CRDA present
	  and if this option is enabled CRDA *will* be called to update the
	  regulatory domain (for US and JP only). Support for letting the user
	  set the regulatory domain through iw is also supported. This option
	  mainly exists to leave around for a kernel release some old static
	  regulatory domains that were defined and to keep around the old
	  ieee80211_regdom module parameter. This is being phased out and you
	  should stop using them ASAP.

	  Note: You will need CRDA if you want 802.11d support

	  Say Y unless you have installed a new userspace application.
	  Also say Y if have one currently depending on the ieee80211_regdom
	  module parameter and cannot port it to use the new userspace
	  interfaces.

config WIRELESS_EXT
	bool "Wireless extensions"
	default n
	---help---
	  This option enables the legacy wireless extensions
	  (wireless network interface configuration via ioctls.)

	  Wireless extensions will be replaced by cfg80211 and
	  will be required only by legacy drivers that implement
	  wireless extension handlers. This option does not
	  affect the wireless-extension backward compatibility
	  code in cfg80211.

	  Say N (if you can) unless you know you need wireless
	  extensions for external modules.

config WIRELESS_EXT_SYSFS
	bool "Wireless extensions sysfs files"
	default y
	depends on WEXT_CORE && SYSFS
	help
	  This option enables the deprecated wireless statistics
	  files in /sys/class/net/*/wireless/. The same information
	  is available via the ioctls as well.

	  Say Y if you have programs using it, like old versions of
	  hal.

config LIB80211
	tristate "Common routines for IEEE802.11 drivers"
	default n
	help
	  This options enables a library of common routines used
	  by IEEE802.11 wireless LAN drivers.

	  Drivers should select this themselves if needed.  Say Y if
	  you want this built into your kernel.

config LIB80211_CRYPT_WEP
	tristate

config LIB80211_CRYPT_CCMP
	tristate

config LIB80211_CRYPT_TKIP
	tristate

config LIB80211_DEBUG
	bool "lib80211 debugging messages"
	depends on LIB80211
	default n
	---help---
	  You can enable this if you want verbose debugging messages
	  from lib80211.

	  If unsure, say N.
```
