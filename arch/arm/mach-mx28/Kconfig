## arch/arm/mach-ns9xxx/include/mach/display/Kconfig
```kconfig
# arch/arm/mach-ns9xxx/displays/Kconfig
#
# Copyright 2009 Digi International Inc
#

if (CC9P9360JS_FB || CCX9C_FB)

comment "Display selection"

config NS9XXX_FB_VGA
	bool "CRT VGA video support"
	depends on ! (CC9P9360JS_SERIAL_PORTA_FULL || CCX9C_SERIAL_PORTA_FULL || CCW9C_SERIAL_PORTA_FULL)
	def_bool y
	help
	  This enables the video support for the VGA intrface.

config NS9XXX_FB_LQ057Q3DC12I
	bool "LQ057Q3DC12I TFT LCD support"
	depends on ! (CC9P9360JS_SERIAL_PORTA_FULL || CCX9C_SERIAL_PORTA_FULL || CCW9C_SERIAL_PORTA_FULL)
	help
	  This enables the support for the LQ057Q3DC12I TFT display.

config NS9XXX_FB_LQ064V3DG01
	bool "LQ064V3DG01 TFT LCD support"
	depends on ! (CC9P9360JS_SERIAL_PORTA_FULL || CCX9C_SERIAL_PORTA_FULL || CCW9C_SERIAL_PORTA_FULL)
	help
	  This enables the support for the LQ064V3DG01 TFT display.

config NS9XXX_FB_CUSTOM
	bool "Custom display support"
	depends on ! (CC9P9360JS_SERIAL_PORTA_FULL || CCX9C_SERIAL_PORTA_FULL || CCW9C_SERIAL_PORTA_FULL)
	help
	  This enables the support for a customer specific display.
	  displays/CUSTOM.h has to be modified when selecting this.

endif
```

## arch/arm/mach-s3c2443/Kconfig
```kconfig
# Copyright 2007 Simtec Electronics
#
# Licensed under GPLv2

config CPU_S3C2443
	bool
	depends on ARCH_S3C2410
	select S3C2443_DMA if S3C2410_DMA
	select CPU_LLSERIAL_S3C2440
	select SAMSUNG_CLKSRC
	select S3C2443_CLOCK
	select S3C_GPIO_PULL_UPDOWN
	help
	  Support for the S3C2443 SoC from the S3C24XX line

config S3C2443_DMA
	bool
	depends on CPU_S3C2443
	help
	  Internal config node for S3C2443 DMA support

menu "S3C2443 Machines"

choice
	prompt "S3C2443 Machines"

config MACH_SMDK2443
	bool "SMDK2443"
	select CPU_S3C2443
	select MACH_SMDK
	select S3C_DEV_HSMMC
	help
	  Say Y here if you are using an SMDK2443

config MACH_CC9M2443JS
	bool "ConnectCore 9M 2443 on a JSCC9M2443 Devboard"
	select CPU_S3C2443
	select MACH_CC9M2443JS_PM if PM
	help
	  Say Y here if you are using the ConnectCore 9M 2443 module
	  on a JSCC9M2443 Development Board

config MACH_CCW9M2443JS
	bool "ConnectCore Wi-9M 2443 on a JSCC9M2443 Devboard"
	select CPU_S3C2443
	select MACH_CC9M2443JS_PM if PM
	help
	  Say Y here if you are using the ConnectCore Wi-9M 2443 module
	  on a JSCC9M2443 Development Board

endchoice

config MACH_CC9M2443JS_GPIOLIB
	bool "Enables the machine's GPIO-Lib"
	depends on (MACH_CC9M2443JS || MACH_CCW9M2443JS)
	help
	  Say Y to enable the GPIO-Lib support for the ConnectCore 9M 2443 module
	  on a JSCC9M2443 Development Board

config MACH_CC9M2443JS_PM
	bool
	depends on (MACH_CC9M2443JS || MACH_CCW9M2443JS) && PM
	help
	  Internal config for the Power Management support on the CC9M2443JS

config MACH_CC9M2443JS_USB
	bool "Enable the USB overload protection"
	depends on (MACH_CC9M2443JS || MACH_CCW9M2443JS) && USB_OHCI_HCD
	default y
	help
	  Enable the overload protection for the ConnectCore 9M 2443 module on a
	  JSCC9M2443 Development Board.

config S3C2443_USB_PHY
	bool "Enable the USB PHY for the S3C2443"
	depends on CPU_S3C2443
	depends on USB_SUPPORT
	default y
	help
	  This option enables the USB PHY on the S3C2443.

	  IMPORTANT: After enabling/disabling the functionality of the USB PHY
	  please verify that the UDC controller is correctly configured. When
	  disabling the S3C2443-UDC the configuration menu selects automatically
	  another one. The reconfiguration can be done under:

	  Device Drivers > USB support > USB Gadget Support

choice
	prompt "Functionality"
	depends on S3C2443_USB_PHY
	bool

config S3C2443_USB_PHY_UDC
	bool "Device Controller"
	select USB_GADGET
	select USB_GADGET_SELECTED
	select USB_GADGET_DUALSPEED
	select USB_GADGET_S3C2443
	select USB_S3C2443
	help
	  This option enables the USB PHY to work as device controller. Additionally
	  it enables the USB Gadget framework.

config S3C2443_USB_PHY_PORT
	bool "Second root hub port"
	select USB_OHCI_HCD
	help
	  This options enables the USB PHY to work as second USB root hub port.

endchoice # S3C2443_USB_PHY

source "arch/arm/mach-s3c2443/displays/Kconfig"

endmenu
```

## arch/arm/mach-s3c2443/displays/Kconfig
```kconfig
# arch/arm/mach-s3c2443/displays/Kconfig
#
# Copyright 2009 Digi International Inc
#

if FB_S3C2443_TFT

comment "Display selection"

config CC9M2443_VGA
	bool "CRT VGA video support"
	def_bool y
	help
	  This enables the video support for the VGA intrface.

config CC9M2443_LQ057Q3DC12I
	bool "LQ057Q3DC12I TFT LCD support"
	help
	  This enables the support for the LQ057Q3DC12I TFT display.

config CC9M2443_LQ064V3DG01
	bool "LQ064V3DG01 TFT LCD support"
	help
	  This enables the support for the LQ064V3DG01 TFT display.

config CC9M2443_LQ070Y3DG3B1
	bool "LQ070Y3DG3B1 TFT LCD support"
	help
	  This enables the support for the LQ070Y3DG3B1 TFT display.

config CC9M2443_CUSTOM
	bool "Custom display support"
	help
	  This enables the support for a customer specific display.
	  displays/CUSTOM.h has to be modified when selecting this.

endif
```

## arch/arm/plat-mxs/Kconfig
```kconfig
if ARCH_MXS

menu "Freescale i.MXS implementations"

choice
	prompt "Select i.MXS chip family"

config ARCH_MX28
	bool "Freescale MX28"
	select CPU_ARM926T
	select FIQ
	select MXS_ICOLL
	select MXS_DMA_ENGINE
	select MXS_AUART_DMA_SUPPORT
	select ARCH_HAS_CPUFREQ
	select WORKAROUND_ARCUSB_REG_RW
	---help---
	 Support Freescale MX28 chips

config ARCH_MX23
	bool "Freescale MX23"
	select CPU_ARM926T
	select FIQ
	select ZONE_DMA
	select MXS_ICOLL
	select MXS_DMA_ENGINE
	select MXS_AUART_DMA_SUPPORT
	select ARCH_HAS_CPUFREQ
	---help---
	Support Freescale MX23 chips

endchoice

if ARCH_MX28
source arch/arm/mach-mx28/Kconfig
endif

if ARCH_MX23
source arch/arm/mach-mx23/Kconfig
endif

config DMA_ZONE
	bool "Add a DMA zone"
	default y
	select ZONE_DMA
	help
	  Create a zone to reserve memory for DMA.

config DMA_ZONE_SIZE
	int "DMA memory zone size"
	depends on ZONE_DMA
	range 0 64
	default 16
	help
	    This is the size in MB for the DMA zone. The DMA zone is used for
	    dedicated memory for large contiguous video buffers

config MXS_CONSISTENT_DMA_SIZE
	int "Consistent DMA memory size (MB)"
	range 2 32
	default 32
	help
	  Set the DMA consistent memory size according to your video
	  memory needs, for example if you want to use multiple planes.
	  The size must be 2MB aligned.

endmenu

config MXS_ICOLL
	bool

config MXS_EARLY_CONSOLE
	bool "Enable console early"
	default y
	help
	  Enable console early for kernel debug.

config MXS_DMA_ENGINE
	bool "Enable DMA ENGINE support"
	default y
	help
	  Support DMA controller on AHB-APBH and AHB-APBX Bridge

config MXS_LRADC
	bool "Low Resolution ADC support"
	default y
	depends on ARCH_MXS
	help
	  Enable LRADC support

config MXS_PWM_CHANNELS
	int
	default 8
	help
	  The number of pwm channel on Freescale MXS platform.

menu "Freescale Application UART"

config MXS_AUART_DMA_SUPPORT
	bool
	depends on MXS_DMA_ENGINE
	default y

config MXS_AUART_PORTS
	int
	default 5

config MXS_AUART0_DEVICE_ENABLE
	bool "Application uart 0 enabled"
	depends on !MODULE_CCARDIMX28 || BT
	default y
	help
	  Enable application uart 0

choice
	prompt "Select the mode:"
	default MXS_AUART0_2WIRE
	depends on MXS_AUART0_DEVICE_ENABLE

config MXS_AUART0_2WIRE
	bool "2 wire (RX, TX)"

config MXS_AUART0_4WIRE
	bool "4 wire (RX, TX, CTS, RTS)"
endchoice

config MXS_AUART0_GPIO_CTS_RTS
	bool "Application uart 0 CTS/RTS on GPIO pins"
	depends on MXS_AUART0_DEVICE_ENABLE && MXS_AUART0_4WIRE
	default n

config MXS_AUART0_GPIO_CTS_PIN
	int "Application uart 0 GPIO CTS pin"
	depends on MXS_AUART0_GPIO_CTS_RTS
	default -1
	help
	  The default pin is unconfigured.
	  Refer to arch/arm/plat-mxs/include/mach/pinctrl.h for pin mapping.

config MXS_AUART0_GPIO_RTS_PIN
	int "Application uart 0 GPIO RTS pin"
	depends on MXS_AUART0_GPIO_CTS_RTS
	default -1
	help
	  The default pin is unconfigured.
	  Refer to arch/arm/plat-mxs/include/mach/pinctrl.h for pin mapping.

config MXS_AUART0_DMA_ENABLE
	bool "Set application uart 0 to dma mode"
	default n
	depends on MXS_AUART_DMA_SUPPORT && MXS_AUART0_DEVICE_ENABLE
	help
	  Set application uart 0 to dma mode

config MXS_AUART1_DEVICE_ENABLE
	bool "Application uart 1 enabled"
	default y
	help
	  Enable application uart 1

choice
	prompt "Select the mode:"
	default MXS_AUART1_2WIRE
	depends on MXS_AUART1_DEVICE_ENABLE

config MXS_AUART1_2WIRE
	bool "2 wire (RX, TX)"

config MXS_AUART1_4WIRE
	bool "4 wire (RX, TX, CTS, RTS)"
endchoice

config MXS_AUART1_GPIO_CTS_RTS
	bool "Application uart 1 CTS/RTS on GPIO pins"
	depends on MXS_AUART1_DEVICE_ENABLE && MXS_AUART1_4WIRE
	default n

config MXS_AUART1_GPIO_CTS_PIN
	int "Application uart 1 GPIO CTS pin"
	depends on MXS_AUART1_GPIO_CTS_RTS
	default 49
	help
	  The default pin is GPIO1_17.
	  Refer to arch/arm/plat-mxs/include/mach/pinctrl.h for pin mapping.

config MXS_AUART1_GPIO_RTS_PIN
	int "Application uart 1 GPIO RTS pin"
	depends on MXS_AUART1_GPIO_CTS_RTS
	default 54
	help
	  The default pin is GPIO1_22.
	  Refer to arch/arm/plat-mxs/include/mach/pinctrl.h for pin mapping.

config MXS_AUART1_DMA_ENABLE
	bool "Set application uart 1 to dma mode"
	default n
	depends on MXS_AUART_DMA_SUPPORT && MXS_AUART1_DEVICE_ENABLE
	help
	  Set application uart 1 to dma mode

config MXS_AUART2_DEVICE_ENABLE
	bool "Application uart 2 enabled"
	default y
	help
	  Enable application uart 2

choice
	prompt "Select the mode:"
	default MXS_AUART2_2WIRE
	depends on MXS_AUART2_DEVICE_ENABLE

config MXS_AUART2_2WIRE
	bool "2 wire (RX, TX)"

config MXS_AUART2_4WIRE
	bool "4 wire (RX, TX, CTS, RTS)"
endchoice

config MXS_AUART2_GPIO_CTS_RTS
	bool "Application uart 2 CTS/RTS on GPIO pins"
	depends on MXS_AUART2_DEVICE_ENABLE && MXS_AUART2_4WIRE
	default n

config MXS_AUART2_GPIO_CTS_PIN
	int "Application uart 2 GPIO CTS pin"
	depends on MXS_AUART2_GPIO_CTS_RTS
	default -1
	help
	  The default pin is unconfigured.
	  Refer to arch/arm/plat-mxs/include/mach/pinctrl.h for pin mapping.

config MXS_AUART2_GPIO_RTS_PIN
	int "Application uart 2 GPIO RTS pin"
	depends on MXS_AUART2_GPIO_CTS_RTS
	default -1
	help
	  The default pin is unconfigured.
	  Refer to arch/arm/plat-mxs/include/mach/pinctrl.h for pin mapping.

config MXS_AUART2_DMA_ENABLE
	bool "Set application uart 2 to dma mode"
	default n
	depends on MXS_AUART_DMA_SUPPORT && MXS_AUART2_DEVICE_ENABLE
	help
	  Set application uart 2 to dma mode

config MXS_AUART3_DEVICE_ENABLE
	bool "Application uart 3 enabled"
	default y
	help
	  Enable application uart 3

choice
	prompt "Select the mode:"
	default MXS_AUART3_2WIRE
	depends on MXS_AUART3_DEVICE_ENABLE

config MXS_AUART3_2WIRE
	bool "2 wire (RX, TX)"

config MXS_AUART3_4WIRE
	bool "4 wire (RX, TX, CTS, RTS)"
endchoice

config MXS_AUART3_GPIO_CTS_RTS
	bool "Application uart 3 CTS/RTS on GPIO pins"
	depends on MXS_AUART3_DEVICE_ENABLE && MXS_AUART3_4WIRE
	default n

config MXS_AUART3_GPIO_CTS_PIN
	int "Application uart 3 GPIO CTS pin"
	depends on MXS_AUART3_GPIO_CTS_RTS
	default 113
	help
	  The default pin is GPIO3_17.
	  Refer to arch/arm/plat-mxs/include/mach/pinctrl.h for pin mapping.

config MXS_AUART3_GPIO_RTS_PIN
	int "Application uart 3 GPIO RTS pin"
	depends on MXS_AUART3_GPIO_CTS_RTS
	default 98
	help
	  The default pin is GPIO3_2.
	  Refer to arch/arm/plat-mxs/include/mach/pinctrl.h for pin mapping.

config MXS_AUART3_DMA_ENABLE
	bool "Set application uart 3 to dma mode"
	default n
	depends on MXS_AUART_DMA_SUPPORT && MXS_AUART3_DEVICE_ENABLE
	help
	  Set application uart 3 to dma mode

config MXS_AUART4_DEVICE_ENABLE
	bool "Application uart 4 enabled"
	default y
	help
	  Enable application uart 4

choice
	prompt "Select the mode:"
	default MXS_AUART4_2WIRE
	depends on MXS_AUART4_DEVICE_ENABLE

config MXS_AUART4_2WIRE
	bool "2 wire (RX, TX)"

config MXS_AUART4_4WIRE
	bool "4 wire (RX, TX, CTS, RTS)"
endchoice

config MXS_AUART4_GPIO_CTS_RTS
	bool "Application uart 4 CTS/RTS on GPIO pins"
	depends on MXS_AUART4_DEVICE_ENABLE && MXS_AUART4_4WIRE
	default n

config MXS_AUART4_GPIO_CTS_PIN
	int "Application uart 4 GPIO CTS pin"
	depends on MXS_AUART4_GPIO_CTS_RTS
	default -1
	help
	  The default pin is unconfigured.
	  Refer to arch/arm/plat-mxs/include/mach/pinctrl.h for pin mapping.

config MXS_AUART4_GPIO_RTS_PIN
	int "Application uart 4 GPIO RTS pin"
	depends on MXS_AUART4_GPIO_CTS_RTS
	default -1
	help
	  The default pin is unconfigured.
	  Refer to arch/arm/plat-mxs/include/mach/pinctrl.h for pin mapping.

config MXS_AUART4_DMA_ENABLE
	bool "Set application uart 4 to dma mode"
	default n
	depends on MXS_AUART_DMA_SUPPORT && MXS_AUART4_DEVICE_ENABLE
	help
	  Set application uart 4 to dma mode

endmenu

endif
```
