/*
 * Copyright 2013 Digi International, Inc.
 *
 * The code contained herein is licensed under the GNU General Public
 * License. You may obtain a copy of the GNU General Public License
 * Version 2 or later at the following locations:
 *
 * http://www.opensource.org/licenses/gpl-license.html
 * http://www.gnu.org/copyleft/gpl.html
 */

/ {
	apb@80000000 {
		apbx@80040000 {
			auart2: serial@8006e000 {
				pinctrl-names = "default";
				pinctrl-0 = <&auart2_3pins_a>;
				linux,rs485-enabled-at-boot-time;
				rs485-rts-active-high;
                                rs485-rts-delay = <0 0>;
				status = "okay";
			};
		};
	};
};
